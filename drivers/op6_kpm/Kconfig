## drivers/op6_kpm/Kconfig
```kconfig
# SPDX-License-Identifier: GPL-2.0-only
config OP6_KPM_RUNTIME
    bool "OP6 native KPM control ABI and ELF inspector (non-executing)"
    depends on ARM64 && MODULES && KSU
    default n
    help
      Privileged ABI v1; validates a KPM ELF file but DOES NOT LOAD IT.

config OP6_KPM_RELOCATION
    bool "OP6 ARM64 KPM relocation engine (object compilation only)"
    depends on OP6_KPM_RUNTIME && ARM64
    default n
    help
      Compile the reviewed upstream AArch64 ELF RELA relocation backend.
      This does NOT yet load, execute or hook any KPM.
```

## drivers/rekernel/Kconfig
```kconfig
menu "Re:Kernel"

config REKERNEL
	bool "Re:Kernel support"
	default n
	help
	  Make tombstone users get a better experience.

config REKERNEL_NETWORK
	bool "Re:Kernel NetReceive unfreeze support"
	depends on REKERNEL && NETFILTER
	default n
	help
	  Make tombstone users get a better experience.
endmenu
```

## fs/susfs-419/Kconfig
```kconfig
# SUSFS 2.3.0 native 4.19 backport; do not switch BakaSU's hook method.
config SUSFS_NATIVE_419
	bool "Native SUSFS 2.3.0 core (experimental Linux 4.19)"
	depends on KSU && KSU_MANUAL_HOOK && ARM64 && 64BIT && THREAD_INFO_IN_TASK
	depends on FUSE_FS && FSNOTIFY
	default n
	help
	  Compile SUSFS natively into the 4.19 kernel, using the existing
	  BakaSU manual hooks. No dynamic kernel memory patching or LKM.
	  Unfinished native backport: do not deploy to a primary device.

config SUSFS_NATIVE_419_UNAME
	bool "SUSFS uname interception (experimental)"
	depends on SUSFS_NATIVE_419
	default n
	help
	  Enable the 4.19 uname VFS-adjacent call site; remains inert
	  until the SUSFS control ABI installs a uname rule.

config SUSFS_NATIVE_419_PATH
	bool "SUSFS path controls (not ready for production)"
	depends on SUSFS_NATIVE_419
	default n
	help
	  Enable native SUSFS path flagging support only in a test
	  kernel with complete VFS and user-space ABI integration.
```
